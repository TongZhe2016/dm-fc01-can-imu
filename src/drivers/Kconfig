## src/drivers/Kconfig
```kconfig
source "src/drivers/cdcacm_autostart/Kconfig"
source "src/drivers/imu/bosch/bmi088/Kconfig"
source "src/drivers/imu/invensense/icm45686/Kconfig"
```

## src/drivers/cdcacm_autostart/Kconfig
```kconfig
menuconfig DRIVERS_CDCACM_AUTOSTART
	bool "cdcacm_autostart"
	default n
	depends on MODULES_MAVLINK || MODULES_CAN_IMU
	---help---
		Enable support for cdcacm_autostart
```
